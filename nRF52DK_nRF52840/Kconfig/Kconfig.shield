## nRF52DK_nRF52840/Kconfig/Kconfig.shield
```kconfig
osource "c:/users/petrikas.lu/desktop/work/nrf/nrf52_lora/boards/shields/*/Kconfig.shield"
osource "./boards/shields/*/Kconfig.shield"
osource "C:/Users/petrikas.lu/Desktop/WORK/NRF/nrf52_lora/./boards/shields/*/Kconfig.shield"
osource "C:/ncs/v2.4.0/nrf/boards/shields/*/Kconfig.shield"
```

## nRF52DK_nRF52840/Kconfig/Kconfig.shield.defconfig
```kconfig
osource "c:/users/petrikas.lu/desktop/work/nrf/nrf52_lora/boards/shields/*/Kconfig.defconfig"
osource "./boards/shields/*/Kconfig.defconfig"
osource "C:/Users/petrikas.lu/Desktop/WORK/NRF/nrf52_lora/./boards/shields/*/Kconfig.defconfig"
osource "C:/ncs/v2.4.0/nrf/boards/shields/*/Kconfig.defconfig"
```
